## CMakeLists.txt
```
# SPDX-License-Identifier: Apache-2.0

cmake_minimum_required(VERSION 3.20.0)

set(SOURCES
  src/main.c
  src/test_suite_setup_public_identity.c
  src/test_suite_setup_static_random_identity.c
)

project(bt_id_init)

# Suppress the format-zero-length error if GNUC is used
if (CMAKE_C_COMPILER_ID MATCHES "GNU")
add_compile_options(-Wno-error=format-zero-length -Wno-format-zero-length)
endif()

find_package(Zephyr COMPONENTS unittest HINTS $ENV{ZEPHYR_BASE})

add_subdirectory(${ZEPHYR_BASE}/tests/bluetooth/host host_mocks)
add_subdirectory(${ZEPHYR_BASE}/tests/bluetooth/host/id mocks)

target_link_libraries(testbinary PRIVATE mocks host_mocks)
```

## prj.conf
```kconfig
CONFIG_ZTEST=y
CONFIG_BT=y
CONFIG_BT_CENTRAL=y
# CONFIG_BT_MAX_PAIRED=7
CONFIG_ASSERT=y
CONFIG_ASSERT_LEVEL=2
CONFIG_ASSERT_VERBOSE=y
```

## src/main.c
```c
/*
 * Copyright (c) 2022 Nordic Semiconductor ASA
 *
 * SPDX-License-Identifier: Apache-2.0
 */

#include <zephyr/zephyr.h>
#include <bluetooth/bluetooth.h>
#include <keys.h>
#include <id.h>
#include "host_mocks/assert.h"

/*
 *  Test function with non-existing item
 *
 *  Constraints:
 *   - Valid values of non-existing items are used
 *
 *  Expected behaviour:
 *   - NULL reference is returned
 */
void test_find_non_existing_item(void)
{
	bt_id_init();
}

void test_main(void)
{

	ztest_test_suite(bt_keys_find_item_empty_list,
			 ztest_unit_test(test_find_non_existing_item));

	ztest_run_test_suite(bt_keys_find_item_empty_list);
}
```
