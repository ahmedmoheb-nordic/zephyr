## CMakeLists.txt
```
# SPDX-License-Identifier: Apache-2.0

cmake_minimum_required(VERSION 3.20.0)

if (NOT BOARD STREQUAL unit_testing)
  message(FATAL_ERROR "This project can only be used with '-DBOARD=unit_testing'.")
endif()

FILE(GLOB SOURCES src/*.c)

project(bt_keys_get_addr)
find_package(Zephyr COMPONENTS unittest HINTS $ENV{ZEPHYR_BASE})

include(${ZEPHYR_BASE}/tests/bluetooth/host/host_mocks.cmake)
include(${ZEPHYR_BASE}/tests/bluetooth/host/keys/mocks.cmake)

target_sources(testbinary PRIVATE ${host_module} ${module_mocks} ${host_mocks})
```

## prj.conf
```kconfig
CONFIG_ZTEST=y
CONFIG_BT=y
CONFIG_BT_CENTRAL=y
CONFIG_BT_MAX_PAIRED=4
CONFIG_ASSERT=y
CONFIG_ASSERT_LEVEL=2
CONFIG_ASSERT_VERBOSE=y
```

## src/main.c
```c
/*
 * Copyright (c) 2022 Nordic Semiconductor ASA
 *
 * SPDX-License-Identifier: Apache-2.0
 */

#include <zephyr/zephyr.h>
#include "testing_common_defs.h"
#include <addr.h>
#include <keys.h>
#include "host_mocks/print_utils.h"
#include "mocks/keys_help_utils.h"

/* This LUT contains different combinations of ID and Address pairs */
const struct id_addr_pair testing_id_addr_pair_lut[CONFIG_BT_MAX_PAIRED] = {
	{ BT_ADDR_ID_1, BT_ADDR_LE_1 },
	{ BT_ADDR_ID_1, BT_ADDR_LE_2 },
	{ BT_ADDR_ID_2, BT_ADDR_LE_1 },
	{ BT_ADDR_ID_2, BT_ADDR_LE_2 }
};

/* Global iterator to iterate over the ID, Address pairs LUT */
static uint8_t params_it;

/* Pointer to the current set of testing parameters */
struct id_addr_pair const *current_params_vector;

/* This list will hold returned references while filling keys pool */
struct bt_keys *returned_keys_refs[CONFIG_BT_MAX_PAIRED];

BUILD_ASSERT(ARRAY_SIZE(testing_id_addr_pair_lut) == CONFIG_BT_MAX_PAIRED);
BUILD_ASSERT(ARRAY_SIZE(testing_id_addr_pair_lut) == ARRAY_SIZE(returned_keys_refs));

/*
 *  Test list is empty
 *
 *  Constraints:
 *   - Empty list at start up
 *
 *  Expected behaviour:
 *   - List is empty at start up
 */
void test_list_is_empty_at_startup(void)
{
	zassert_true(check_key_pool_is_empty(),
		     "List isn't empty, make sure to run this test just after a fresh start");
}

/*
 *  Test filling the keys pool with (ID, Address) pairs
 *
 *  Constraints:
 *   - Empty list at startup
 *
 *  Expected behaviour:
 *   - A valid reference is returned by bt_keys_get_addr()
 *   - ID value matches the one passed to bt_keys_get_addr()
 *   - Address value matches the one passed to bt_keys_get_addr()
 */
void test_get_non_existing_keys(void)
{
	bt_addr_le_t addr;
	struct bt_keys *returned_key;
	uint8_t id = current_params_vector->id;

	bt_addr_le_copy(&addr, current_params_vector->addr);

	returned_key = bt_keys_get_addr(id, &addr);
	/* 'params_it' is incremented before running the test case */
	returned_keys_refs[params_it - 1] = returned_key;

	zassert_true(returned_key != NULL, "bt_keys_get_addr() returned a non-valid reference");
	zassert_true(returned_key->id == id,
		     "bt_keys_get_addr() returned a reference with an incorrect ID");
	zassert_true(!bt_addr_le_cmp(&returned_key->addr, &addr),
		     "bt_keys_get_addr() set incorrect address %s value, expected %s",
		     bt_addr_le_str(&returned_key->addr), bt_addr_le_str(&addr));
	zassert_false(check_key_pool_is_empty(),
		      "List is empty, (ID, Address) pair insertion failed");
}

/*
 *  Test no equal references returned by bt_keys_get_addr()
 *
 *  Constraints:
 *   - Keys pool has been filled
 *
 *  Expected behaviour:
 *   - All returned references are different from each other
 */
void test_no_equal_references(void)
{
	struct bt_keys *keys_pool = bt_keys_get_key_pool();

	for (uint32_t i = 0; i < ARRAY_SIZE(returned_keys_refs); i++) {
		struct bt_keys *returned_ref = returned_keys_refs[i];

		zassert_equal_ptr(keys_pool + i, returned_ref,
				  "bt_keys_get_addr() returned unexpected reference at slot %u", i);
	}
}

/*
 *  Test getting a valid key reference by a matching ID and address
 *
 *  Constraints:
 *   - ID and address pair has been inserted in the list
 *
 *  Expected behaviour:
 *   - A valid reference is returned by bt_keys_get_addr() that
 *     matches the one returned after adding the ID and address pair
 *   - ID value matches the one passed to bt_keys_get_addr()
 *   - Address value matches the one passed to bt_keys_get_addr()
 */
void test_get_key_by_matched_id_and_address(void)
{
	bt_addr_le_t addr;
	struct bt_keys *returned_key, *expected_key_ref;
	uint8_t id = current_params_vector->id;

	bt_addr_le_copy(&addr, current_params_vector->addr);

	returned_key = bt_keys_get_addr(id, &addr);
	/* 'params_it' is incremented before running the test case */
	expected_key_ref = returned_keys_refs[params_it - 1];

	zassert_true(returned_key != NULL, "bt_keys_get_addr() returned a non-valid reference");
	zassert_equal_ptr(returned_key, expected_key_ref,
			  "bt_keys_get_addr() returned unexpected reference");
}

/* Initialize test variables */
static void reset_global_test_round_params(void)
{
	params_it = 0;
	current_params_vector = NULL;
}

/* Setup test variables */
static void unit_test_setup(void)
{
	zassert_true((params_it < (ARRAY_SIZE(testing_id_addr_pair_lut))),
		     "Invalid testing parameters index %u", params_it);
	current_params_vector = &testing_id_addr_pair_lut[params_it];
	params_it++;
}

void test_main(void)
{
	reset_global_test_round_params();

	/* This testsuite should setup the conditions for subsequent tests
	 *   - Checks the initial startup state of the keys pool to be empty
	 *   - Test bt_keys_get_addr() behaviour when trying to get a key
	 *     reference for non-existing (ID, Address) pair
	 */
	ztest_test_suite(bt_keys_get_addr_get_non_existing_keys,
			 ztest_unit_test(test_list_is_empty_at_startup),
			 LISTIFY(CONFIG_BT_MAX_PAIRED, REGISTER_SETUP_TEARDOWN, (,),
				 test_get_non_existing_keys),
			 ztest_unit_test(test_no_equal_references));

	ztest_run_test_suite(bt_keys_get_addr_get_non_existing_keys);

	reset_global_test_round_params();

	/* Checks when (ID, Address) pairs exist in keys pool */
	ztest_test_suite(bt_keys_get_addr_get_existing_keys,
			 LISTIFY(CONFIG_BT_MAX_PAIRED, REGISTER_SETUP_TEARDOWN, (,),
				 test_get_key_by_matched_id_and_address));

	ztest_run_test_suite(bt_keys_get_addr_get_existing_keys);

	uint32_t state = 0;

	ztest_run_registered_test_suites(&state);
}
```

## src/test_suite_full_list_invalid_values.c
```c
/*
 * Copyright (c) 2022 Nordic Semiconductor ASA
 *
 * SPDX-License-Identifier: Apache-2.0
 */

#include <zephyr/zephyr.h>
#include "testing_common_defs.h"
#include <addr.h>
#include <keys.h>
#include "host_mocks/assert.h"
#include "mocks/conn.h"
#include "mocks/hci_core.h"
#include "mocks/keys_help_utils.h"
#include "mocks/hci_core_expects.h"

/* This call back will be called when bt_unpair() is called with the same parameters
 * It can be used when a call to bt_unpair() isn't expected
 */
static int bt_unpair_unreachable_custom_fake(uint8_t id, const bt_addr_le_t *addr)
{
	ARG_UNUSED(id);
	ARG_UNUSED(addr);
	zassert_unreachable("Unexpected call to 'bt_unpair()' occurred");
	return 0;
}

/* This call back will be called when bt_conn_foreach() is called with the same parameters */
static void bt_conn_foreach_custom_fake_conn_ref_null(int type, bt_conn_foreach_cb func,
							void *data)
{
	expect_assert();
	func(NULL, data);
}

/* This call back will be called when bt_conn_foreach() is called with the same parameters */
static void bt_conn_foreach_custom_fake_data_ref_null(int type, bt_conn_foreach_cb func,
							void *data)
{
	struct bt_conn conn;

	expect_assert();
	func(&conn, NULL);
}

/*
 *  Test adding extra (ID, Address) pair while the keys pool list is full
 *
 *  Constraints:
 *   - Keys pool list is full
 *   - All Keys are used with a connection
 *   - CONFIG_BT_KEYS_OVERWRITE_OLDEST is enabled
 *
 *  Expected behaviour:
 *   - An assertion is triggered and execution stops
 */
void test_find_key_in_use_receives_null_conn_ref(void)
{
	bt_addr_le_t addr;
	uint8_t id = BT_ADDR_ID_5;

	bt_addr_le_copy(&addr, (const bt_addr_le_t *)BT_ADDR_LE_5);

	bt_unpair_fake.custom_fake = bt_unpair_unreachable_custom_fake;
	bt_conn_foreach_fake.custom_fake = bt_conn_foreach_custom_fake_conn_ref_null;

	bt_keys_get_addr(id, &addr);

	/* Should not reach this point */
	zassert_unreachable(NULL);
}

/*
 *  Test adding extra (ID, Address) pair while the keys pool list is full
 *
 *  Constraints:
 *   - Keys pool list is full
 *   - All Keys are used with a connection
 *   - CONFIG_BT_KEYS_OVERWRITE_OLDEST is enabled
 *
 *  Expected behaviour:
 *   - An assertion is triggered and execution stops
 */
void test_find_key_in_use_receives_null_data_ref(void)
{
	bt_addr_le_t addr;
	uint8_t id = BT_ADDR_ID_5;

	bt_addr_le_copy(&addr, (const bt_addr_le_t *)BT_ADDR_LE_5);

	bt_unpair_fake.custom_fake = bt_unpair_unreachable_custom_fake;
	bt_conn_foreach_fake.custom_fake = bt_conn_foreach_custom_fake_data_ref_null;

	bt_keys_get_addr(id, &addr);

	/* Should not reach this point */
	zassert_unreachable(NULL);
}

/*
 *  Test invalid (NULL) BT address reference
 *
 *  Constraints:
 *   - Address value is NULL
 *
 *  Expected behaviour:
 *   - An assertion is raised and execution stops
 */
void test_null_address_reference(void)
{
	expect_assert();
	bt_keys_get_addr(0x00, NULL);
}

/* Setup test variables */
static void unit_test_setup(void)
{
	/* Register resets */
	ASSERT_FFF_FAKES_LIST(RESET_FAKE);
	CONN_FFF_FAKES_LIST(RESET_FAKE);
	HCI_CORE_FFF_FAKES_LIST(RESET_FAKE);
}

static bool pragma_overwrite_enabled(const void *s)
{
	if ((IS_ENABLED(CONFIG_BT_KEYS_OVERWRITE_OLDEST))) {
		return true;
	}

	return false;
}

ztest_register_test_suite(bt_keys_get_addr_null_reference, NULL,
			  ztest_unit_test_setup(test_null_address_reference, unit_test_setup));

ztest_register_test_suite(
	bt_keys_find_key_in_use_invalid_cases, pragma_overwrite_enabled,
	ztest_unit_test_setup(test_find_key_in_use_receives_null_conn_ref, unit_test_setup),
	ztest_unit_test_setup(test_find_key_in_use_receives_null_data_ref, unit_test_setup));
```

## src/test_suite_full_list_no_overwrite.c
```c
/*
 * Copyright (c) 2022 Nordic Semiconductor ASA
 *
 * SPDX-License-Identifier: Apache-2.0
 */

#include <zephyr/zephyr.h>
#include "testing_common_defs.h"
#include <addr.h>
#include <keys.h>
#include "mocks/hci_core_expects.h"

/*
 *  Test adding extra (ID, Address) pair while the keys pool list is full
 *
 *  Constraints:
 *   - Keys pool list is full
 *   - CONFIG_BT_KEYS_OVERWRITE_OLDEST isn't enabled
 *
 *  Expected behaviour:
 *   - NULL reference pointer is returned
 */
void test_adding_new_pair_to_full_list(void)
{
	bt_addr_le_t addr;
	struct bt_keys *returned_key;
	uint8_t id = BT_ADDR_ID_3;

	bt_addr_le_copy(&addr, (const bt_addr_le_t *)BT_ADDR_LE_3);

	returned_key = bt_keys_get_addr(id, &addr);

	expect_not_called_bt_unpair();

	zassert_true(returned_key == NULL, "bt_keys_get_addr() returned a non-NULL reference");
}

static bool pragma_overwrite_not_enabled(const void *s)
{
	if ((IS_ENABLED(CONFIG_BT_KEYS_OVERWRITE_OLDEST))) {
		return false;
	}

	return true;
}

ztest_register_test_suite(bt_keys_get_addr_full_list_no_overwrite, pragma_overwrite_not_enabled,
			  ztest_unit_test(test_adding_new_pair_to_full_list));
```

## src/test_suite_full_list_overwrite_oldest.c
```c
/*
 * Copyright (c) 2022 Nordic Semiconductor ASA
 *
 * SPDX-License-Identifier: Apache-2.0
 */

#include <zephyr/zephyr.h>
#include "testing_common_defs.h"
#include <addr.h>
#include <keys.h>
#include "mocks/conn.h"
#include "mocks/hci_core.h"
#include "mocks/keys_help_utils.h"
#include "mocks/hci_core_expects.h"

/* This LUT contains different combinations of ID and Address pairs */
extern const struct id_addr_pair testing_id_addr_pair_lut[CONFIG_BT_MAX_PAIRED];

/* This list holds returned references while filling keys pool */
extern struct bt_keys *returned_keys_refs[CONFIG_BT_MAX_PAIRED];

/* Pointer to the current set of oldest testing parameter */
struct id_addr_pair const *oldest_params_vector;

/*
 * Update the 'oldest_params_vector' value to point to the oldest set.
 * It returns the index of the oldest parameters
 */
static uint32_t update_oldest_params_vector(void)
{
	static uint32_t oldest_params_idx;

	zassert_true((oldest_params_idx < (ARRAY_SIZE(testing_id_addr_pair_lut))),
		     "Invalid testing parameters index %u", oldest_params_idx);

	oldest_params_vector = &testing_id_addr_pair_lut[oldest_params_idx++];
	if (oldest_params_idx == (ARRAY_SIZE(testing_id_addr_pair_lut))) {
		oldest_params_idx = 0;
	}

	return (oldest_params_vector - &testing_id_addr_pair_lut[0]);
}

/* This call back will be called when bt_unpair() is called with the same parameters
 * It will clear the key slot with the assigned to the 'id'
 */
static int bt_unpair_custom_fake(uint8_t id, const bt_addr_le_t *addr)
{
	struct bt_keys *keys = NULL;

	keys = bt_keys_find_addr(id, addr);
	if (keys) {
		bt_keys_clear(keys);
	}

	/* This check is used here because bt_unpair() is called with a local variable address */
	expect_single_call_bt_unpair(oldest_params_vector->id, oldest_params_vector->addr);

	return 0;
}

/* This call back will be called when bt_unpair() is called with the same parameters
 * It can be used when a call to bt_unpair() isn't expected
 */
static int bt_unpair_unreachable_custom_fake(uint8_t id, const bt_addr_le_t *addr)
{
	ARG_UNUSED(id);
	ARG_UNUSED(addr);
	zassert_unreachable("Unexpected call to 'bt_unpair()' occurred");
	return 0;
}

/* This call back will be called when bt_conn_foreach() is called with the same parameters
 * It will act as if there are some active connections
 */
static void bt_conn_foreach_custom_fake_key_slot_0_in_use(int type, bt_conn_foreach_cb func,
							  void *data)
{
	struct bt_conn conn;

	/* This will make the effect as if there is a disconnection */
	conn.state = BT_CONN_DISCONNECTED;
	func(&conn, data);

	/* This will make the effect as if there is a connection with no key */
	conn.state = BT_CONN_CONNECTED;
	conn.id = 0xFF;
	bt_addr_le_copy(&conn.le.dst, (const bt_addr_le_t *)BT_ADDR_LE_ANY);
	bt_conn_get_dst_fake.return_val = &conn.le.dst;
	func(&conn, data);

	/* This will make the effect as if key at slot 0 is in use with a connection */
	conn.state = BT_CONN_CONNECTED;
	conn.id = testing_id_addr_pair_lut[0].id;
	bt_addr_le_copy(&conn.le.dst, testing_id_addr_pair_lut[0].addr);
	bt_conn_get_dst_fake.return_val = &conn.le.dst;
	func(&conn, data);
}

/* This call back will be called when bt_conn_foreach() is called with the same parameters
 * It will act as if all keys are in used with active connections
 */
static void bt_conn_foreach_custom_fake_all_keys_in_use(int type, bt_conn_foreach_cb func,
							void *data)
{
	struct bt_conn conn;

	/* This will make the effect as if key at slot 'x' is in use with a connection */
	for (size_t i = 0; i < ARRAY_SIZE(testing_id_addr_pair_lut); i++) {
		conn.state = BT_CONN_CONNECTED;
		conn.id = testing_id_addr_pair_lut[i].id;
		bt_addr_le_copy(&conn.le.dst, testing_id_addr_pair_lut[i].addr);
		bt_conn_get_dst_fake.return_val = &conn.le.dst;
		func(&conn, data);
	}
}

/* This call back will be called when bt_conn_foreach() is called with the same parameters
 * It will act as if all keys are in used with active connections
 */
static void bt_conn_foreach_custom_fake_no_keys_in_use(int type, bt_conn_foreach_cb func,
							void *data)
{
	struct bt_conn conn;

	/* This will make the effect as if key at slot 'x' is in use with a connection */
	for (size_t i = 0; i < ARRAY_SIZE(testing_id_addr_pair_lut); i++) {
		conn.state = BT_CONN_DISCONNECTED;
		conn.id = testing_id_addr_pair_lut[i].id;
		bt_addr_le_copy(&conn.le.dst, testing_id_addr_pair_lut[i].addr);
		bt_conn_get_dst_fake.return_val = &conn.le.dst;
		func(&conn, data);
	}
}

/*
 *  Test adding extra (ID, Address) pair while the keys pool list is full
 *
 *  Constraints:
 *   - Keys pool list is full
 *   - All Keys are used with a connection
 *   - CONFIG_BT_KEYS_OVERWRITE_OLDEST is enabled
 *
 *  Expected behaviour:
 *   - NULL pointer is returned as there is no room
 */
void test_add_item_full_list_all_keys_in_use(void)
{
	bt_addr_le_t addr;
	struct bt_keys *returned_key;
	uint8_t id = BT_ADDR_ID_3;

	bt_addr_le_copy(&addr, (const bt_addr_le_t *)BT_ADDR_LE_3);

	bt_unpair_fake.custom_fake = bt_unpair_unreachable_custom_fake;
	bt_conn_foreach_fake.custom_fake = bt_conn_foreach_custom_fake_all_keys_in_use;

	returned_key = bt_keys_get_addr(id, &addr);

	zassert_true(returned_key == NULL, "bt_keys_get_addr() returned a non-NULL reference");
}

/*
 *  Test adding extra (ID, Address) pair while the keys pool list is full
 *
 *  Constraints:
 *   - Keys pool list is full
 *   - All Keys are not used with a connection
 *   - CONFIG_BT_KEYS_OVERWRITE_OLDEST is enabled
 *
 *  Expected behaviour:
 *   - Valid reference pointer is returned which matches the oldest
 *     reference at index 1
 */
void test_add_item_full_list_no_keys_in_use(void)
{
	bt_addr_le_t addr;
	struct bt_keys *returned_key;
	uint8_t id = BT_ADDR_ID_3;
	uint32_t oldest_params_ref_idx;

	bt_addr_le_copy(&addr, (const bt_addr_le_t *)BT_ADDR_LE_3);

	oldest_params_ref_idx = update_oldest_params_vector();
	bt_unpair_fake.custom_fake = bt_unpair_custom_fake;
	bt_conn_foreach_fake.custom_fake = bt_conn_foreach_custom_fake_no_keys_in_use;

	returned_key = bt_keys_get_addr(id, &addr);

	zassert_true(returned_key != NULL, "bt_keys_get_addr() returned a NULL reference");
	zassert_true(returned_key == returned_keys_refs[oldest_params_ref_idx],
		     "bt_keys_get_addr() returned reference doesn't match expected one");
}

/*
 *  Test adding extra (ID, Address) pair while the keys pool list is full
 *
 *  Constraints:
 *   - Keys pool list is full
 *   - Oldest key at slot 0 is used with a connection
 *   - CONFIG_BT_KEYS_OVERWRITE_OLDEST is enabled
 *
 *  Expected behaviour:
 *   - Valid reference pointer is returned which matches the oldest
 *     reference at index 1
 */
void test_add_item_full_list_key_0_in_use_key_1_oldest(void)
{
	bt_addr_le_t addr;
	struct bt_keys *returned_key;
	uint8_t id = BT_ADDR_ID_4;
	uint32_t oldest_params_ref_idx;

	bt_addr_le_copy(&addr, (const bt_addr_le_t *)BT_ADDR_LE_4);

	bt_unpair_fake.custom_fake = bt_unpair_custom_fake;
	bt_conn_foreach_fake.custom_fake = bt_conn_foreach_custom_fake_key_slot_0_in_use;

	oldest_params_ref_idx = update_oldest_params_vector();

	returned_key = bt_keys_get_addr(id, &addr);

	zassert_true(returned_key != NULL, "bt_keys_get_addr() returned a NULL reference");
	zassert_true(returned_key == returned_keys_refs[oldest_params_ref_idx],
		     "bt_keys_get_addr() returned reference doesn't match expected one");
}

/*
 *  Test adding extra (ID, Address) pair while the keys pool list is full
 *
 *  Constraints:
 *   - Keys pool list is full
 *   - Key at slot 0 is used with a connection
 *   - Oldest key isn't used with a connection
 *   - CONFIG_BT_KEYS_OVERWRITE_OLDEST is enabled
 *
 *  Expected behaviour:
 *   - Valid reference pointer is returned which matches the oldest
 *     reference at index 2
 */
void test_add_item_full_list_key_0_in_use_key_2_oldest(void)
{
	bt_addr_le_t addr;
	struct bt_keys *returned_key;
	uint8_t id = BT_ADDR_ID_5;
	uint32_t oldest_params_ref_idx;

	bt_addr_le_copy(&addr, (const bt_addr_le_t *)BT_ADDR_LE_5);

	oldest_params_ref_idx = update_oldest_params_vector();
	bt_unpair_fake.custom_fake = bt_unpair_custom_fake;
	bt_conn_foreach_fake.custom_fake = bt_conn_foreach_custom_fake_key_slot_0_in_use;

	returned_key = bt_keys_get_addr(id, &addr);

	zassert_true(returned_key != NULL, "bt_keys_get_addr() returned a NULL reference");
	zassert_true(returned_key == returned_keys_refs[oldest_params_ref_idx],
		     "bt_keys_get_addr() returned reference doesn't match expected one");
}

/* Setup test variables */
static void unit_test_setup(void)
{
	/* Register resets */
	CONN_FFF_FAKES_LIST(RESET_FAKE);
	HCI_CORE_FFF_FAKES_LIST(RESET_FAKE);
}

static bool pragma_overwrite_enabled(const void *s)
{
	if ((IS_ENABLED(CONFIG_BT_KEYS_OVERWRITE_OLDEST))) {
		return true;
	}

	return false;
}

/* This test suite verifies the order at which the oldest key is overwritten.
 * So, the output is dependent on the order of execution.
 */
ztest_register_test_suite(
	bt_keys_get_addr_full_list_overwrite_oldest, pragma_overwrite_enabled,
	ztest_unit_test_setup(test_add_item_full_list_all_keys_in_use, unit_test_setup),
	ztest_unit_test_setup(test_add_item_full_list_no_keys_in_use, unit_test_setup),
	ztest_unit_test_setup(test_add_item_full_list_key_0_in_use_key_1_oldest, unit_test_setup),
	ztest_unit_test_setup(test_add_item_full_list_key_0_in_use_key_2_oldest, unit_test_setup));
```
